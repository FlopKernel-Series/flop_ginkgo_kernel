## drivers/fstabdt_disable/Kconfig
```kconfig
menuconfig FSTABDT_DISABLE
	bool "Driver to Disable Fstab Entry in Device Tree"
	help
	  This driver modifies the device tree to disable the fstab entry.
```

## drivers/kernelsu/kernel/Kconfig
```kconfig
menu "KernelSU"

config KSU
	tristate "KernelSU function support"
	depends on OVERLAY_FS
	default n
	help
	  Enable kernel-level root privileges on Android System.
	  To compile as a module, choose M here: the
	  module will be called kernelsu.

config KSU_DEBUG
	bool "KernelSU debug mode"
	depends on KSU
	default n
	help
	  Enable KernelSU debug mode.

menu "KernelSU - SUSFS"
config KSU_SUSFS
    bool "KernelSU addon - SUSFS"
    depends on KSU
    default y
    help
      Patch and Enable SUSFS to kernel with KernelSU.

config KSU_SUSFS_SUS_PATH
    bool "Enable to hide suspicious path (NOT recommended)"
    depends on KSU_SUSFS
    default y
    help
      - Allow hiding the user-defined path and all its sub-paths from various system calls.
      - Effective on process with uid > 2000 only.
      - Use with cautious as it may cause performance loss and will be vulnerable to side channel attacks,
        just disable this feature if it doesn't work for you or you don't need it at all.

config KSU_SUSFS_SUS_MOUNT
    bool "Enable to hide suspicious mounts"
    depends on KSU_SUSFS
    default y
    help
      - Allow hiding the user-defined mount paths from /proc/self/[mounts|mountinfo|mountstat].
      - Effective on all processes for hiding mount entries.
      - The mnt_id, parent_mnt_id and mnt_group_id will be reordered as well in mountinfo while the actual values are remained unchanged in kernel,
        and this reorder function will be effective on all processes spawned only by the zygote process.

config KSU_SUSFS_SUS_KSTAT
    bool "Enable to spoof suspicious kstat"
    depends on KSU_SUSFS
    default y
    help
      - Allow spoofing the kstat of user-defined file/directory.
      - Effective on all processes.

config KSU_SUSFS_SUS_OVERLAYFS
    bool "Enable to automatically spoof kstat and kstatfs for overlayed files/directories"
    depends on KSU_SUSFS
    default y
    help
      - Automatically spoof the kstat and kstatfs for overlayed files/directories.
      - No susfs command is needed in userspace.
      - Effective on all processes.

config KSU_SUSFS_TRY_UMOUNT
    bool "Enable to use ksu's try_umount"
    depends on KSU_SUSFS
    default y
    help
      - Allow using ksu's umount to umount other user-defined mount paths prior to ksu's default umount paths.
      - Effective on all NO-root-access-granted processes.

config KSU_SUSFS_SPOOF_UNAME
    bool "Enable to spoof uname"
    depends on KSU_SUSFS
    default y
    help
      - Allow spoofing the string returned by uname syscall to user-defined string.
      - Effective on all processes.
      
config KSU_SUSFS_ENABLE_LOG
    bool "Enable logging susfs log to kernel"
    depends on KSU_SUSFS
    default y
    help
      - Allow logging susfs log to kernel, uncheck it to completely disable all susfs log.

config KSU_SUSFS_SUS_SU
    bool "Enable SUS-SU in runtime temporarily (experimental)"
    depends on KSU_SUSFS
    default y
    help
      - Allow user to enable or disable core ksu kprobes hooks temporarily in runtime.
      - When enabling sus_su, kprobes of ksu will be disabled, and a fifo driver will be created in /dev/[random_string].
        (for first time only), then user needs to mount the 'sus_su' to /system/bin/su using overlayfs or whatever techniques,
        and run 'su' to get root shell from the fifo driver. Or, refer to the method in service.sh from module template.
      - When disabling sus_su, kprobes of ksu will be enabled again, and the fifo driver will be deleted.
      - Only apps with root access granted by ksu manager are allowed to get root.
      - Also overlayfs is required.

endmenu

endmenu
```

## nethunter/Kconfig
```kconfig
menu "NetHunter Support"

config NETHUNTER_SUPPORT

	bool "Basic nethunter support"

	default n

	help

		Enable basic nethunter support in-kernel which are sysvipc, module support, hci0 support and mac80211 support.

	select SYSVIPC

	select MODULES

	select MODULE_UNLOAD

	select MODVERSIONS

	select MMC

	select BT

	select BT_BREDR

	select BT_RFCOMM

	select BT_RFCOMM_TTY

	select BT_BNEP

	select BT_BNEP_MC_FILTER

	select BT_BNEP_PROTO_FILTER

	select BT_HIDP

	select BT_HS

	select BT_LE

	select BT_LEDS

	select BT_HCIBTUSB

	select BT_HCIBTSDIO

	select BT_HCIBTUSB_BCM

	select BT_HCIBTUSB_RTL

	select BT_HCIUART

	select BT_HCIVHCI

	select BT_HCIBCM203X

	select BT_HCIBPA10X

	select BT_HCIBFUSB

	select CFG80211_WEXT

	select MAC80211

	select MAC80211_MESH

	select MAC80211_RC_MINSTREL

	select MAC80211_RC_MINSTREL_HT

	select MAC80211_RC_MINSTREL_VHT
	

config NETHUNTER_ETHERNET_SUPPORT

	tristate "Ethernet drivers support"

	default y if NETHUNTER_SUPPORT

	depends on NETHUNTER_SUPPORT

	help

		Enable rtl ethernet drivers support.

	select USB_RTL8150

	select USB_RTL8152
	

config NETHUNTER_SDR_SUPPORT

	tristate "SDR support"

	default y if NETHUNTER_SUPPORT

	depends on NETHUNTER_SUPPORT

	help

		Enable SDR drivers support like airspy, hackrf  and msi2500.

	select MEDIA_SUPPORT

	select MEDIA_DIGITAL_TV_SUPPORT

	select MEDIA_SDR_SUPPORT

	select MEDIA_USB_SUPPORT

	select USB_AIRSPY

	select USB_HACKRF

	select USB_MSI2500


config NETHUNTER_HID_SUPPORT

	tristate "HID support"

	default y if NETHUNTER_SUPPORT

	depends on NETHUNTER_SUPPORT

	help

		Enable HID support to perform HID attacks with external gadgets and such.

	select HID_BATTERY_STRENGTH

	select HIDRAW

	select UHID

	select HID_GENERIC

	select HID_A4TECH
	
	select HID_ACCUTOUCH
	
	select HID_ACRUX
	
	select HID_ACRUX_FF
	
	select HID_APPLE
	
	select HID_APPLEIR
	
	select HID_ASUS
	
	select HID_AUREAL

	select HID_BELKIN

	select HID_BETOP_FF

	select HID_CHERRY

	select HID_CHICONY

	select HID_CORSAIR

	select HID_PRODIKEYS

	select HID_CMEDIA

	select HID_CP2112

	select HID_CYPRESS

	select HID_DRAGONRISE

	select HID_EMS_FF

	select HID_ELECOM

	select HID_ELO

	select HID_EZKEY

	select HID_GEMBIRD

	select HID_GFRM

	select HID_HOLTEK

	select HID_GT683R

	select HID_KEYTOUCH

	select HID_KYE

	select HID_UCLOGIC

	select HID_WALTOP
       
	select HID_GYRATION

	select HID_ICADE

	select HID_ITE

	select HID_TWINHAN

	select HID_KENSINGTON

	select HID_LCPOWER

	select HID_LED

	select HID_LENOVO

	select HID_LOGITECH

	select HID_LOGITECH_DJ

	select HID_LOGITECH_HIDPP

	select HID_MAGICMOUSE

	select HID_MAYFLASH

	select HID_MICROSOFT

	select HID_MONTEREY

	select HID_MULTITOUCH

	select HID_NTI

	select HID_NTRIG

	select HID_ORTEK

	select HID_PANTHERLORD

	select HID_PENMOUNT

	select HID_PETALYNX

	select HID_PICOLCD

	select HID_PICOLCD_FB

	select HID_PICOLCD_BACKLIGHT

	select HID_PICOLCD_LEDS

	select HID_PLANTRONICS
	
	select HID_PRIMAX

	select HID_RETRODE

	select HID_ROCCAT

	select HID_SAITEK

	select HID_SAMSUNG

	select HID_SONY

	select HID_SPEEDLINK

	select HID_STEELSERIES

	select HID_SUNPLUS

	select HID_RMI

	select HID_GREENASIA

	select HID_SMARTJOYPLUS

	select HID_TIVO

	select HID_TOPSEED

	select HID_THINGM

	select HID_THRUSTMASTER

	select HID_UDRAW_PS3

	select HID_WACOM

	select HID_WIIMOTE

	select HID_XINMO

	select HID_ZEROPLUS

	select HID_ZYDACRON

	select HID_SENSOR_HUB

	select HID_SENSOR_CUSTOM_SENSOR

	select HID_ALPS

	select HID_QVR

	select USB_HID

	select HID_PID

	select USB_HIDDEV

	select I2C_HID


config NETHUNTER_USB_SUPPORT

	tristate "USB support"

	default y if NETHUNTER_SUPPORT

	depends on NETHUNTER_SUPPORT

	help

		Enable USB support for nethunter usage like otg access, mtp, rndis and eem.

	select USB_OTG

	select USB_MON

	select USB_XHCI_HCD

	select USB_EHCI_HCD

	select USB_ACM

	select USB_STORAGE

	select USB_SERIAL

	select USB_SERIAL_CH341

	select USB_SERIAL_CP210X

	select USB_SERIAL_FTDI_SIO

	select USB_SERIAL_PL2303

	select USB_GADGET

	select USB_CONFIGFS_SERIAL

	select USB_CONFIGFS_ACM

	select USB_CONFIGFS_OBEX

	select USB_CONFIGFS_NCM

	select USB_CONFIGFS_ECM_SUBSET

	select USB_CONFIGFS_RNDIS

	select USB_CONFIGFS_EEM

	select USB_CONFIGFS_MASS_STORAGE


config NETHUNTER_WIFI_DRIVERS_SUPPORT

	tristate "WiFi drivers support"

	default y if NETHUNTER_SUPPORT

	depends on NETHUNTER_SUPPORT

	help

		Enable ath9k, mt7601, ralink, realtek, and zydas drivers support.

	select WLAN_VENDOR_ATH

	select ATH9K_HTC

	select CARL9170

	select ATH6KL

	select ATH6KL_USB

	select LIBERTAS

	select WLAN_VENDOR_MEDIATEK

	select MT7601U

	select WLAN_VENDOR_RALINK

	select RT2X00

	select RT2500USB

	select RT73USB

	select RT2800USB

	select RT2800USB_RT33XX

	select RT2800USB_RT35XX

	select RT2800USB_RT3573

	select RT2800USB_RT53XX

	select RT2800USB_RT55XX

	select RT2800USB_UNKNOWN

	select WLAN_VENDOR_REALTEK

	select RTL8187

	select RTL_CARDS

	select RTL8192CU

	select RTL8XXXU

	select RTL8XXXU_UNTESTED

	select WLAN_VENDOR_ZYDAS

	select USB_ZD1201

	select ZD1211RW

	select USB_NET_RNDIS_WLAN

endmenu
```
